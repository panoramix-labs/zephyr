## boards/seeed/grove_vision_ai/Kconfig.grove_vision_ai
```kconfig
# Copyright (c) 2024 Panoramix Labs
# SPDX-License-Identifier: Apache-2.0

config BOARD_GROVE_VISION_AI
	select SOC_HX6538_CM55M if BOARD_GROVE_VISION_AI_HX6538_CM55M
	select SOC_HX6538_CM55S if BOARD_GROVE_VISION_AI_HX6538_CM55S
```

## boards/seeed/grove_vision_ai/board.yml
```yaml
board:
  name: grove_vision_ai
  vendor: seeed
  revision:
    format: number
    default: "2"
    exact: true
    revisions:
    - name: "2"
  socs:
  - name: hx6538
```

## drivers/serial/Kconfig.dw_uart
```kconfig
# Copyright (c) 2024 Panoramix Labs
# SPDX-License-Identifier: Apache-2.0

config UART_DW_UART
	bool "Designware UART driver"
	depends on DT_HAS_SNPS_DW_UART_ENABLED
	select SERIAL_HAS_DRIVER
	help
	  Enable the Synopsys Designware UART driver, built into Synopsys ARC
	  SoC as well as other non-Synopsys SoCs.
```

## dts/bindings/serial/snps,dw-uart.yaml
```yaml
# Copyright (c) 2024, Panoramix Labs
# SPDX-License-Identifier: Apache-2.0

description: Synopsys Designware UART, present on ARC and non-ARC SoCs

compatible: "snps,dw-uart"

include: uart-controller.yaml

properties:
  reg:
    required: true
```

## soc/himax/hx6538/Kconfig
```kconfig
# Copyright (c) 2024 Panoramix Labs
# SPDX-License-Identifier: Apache-2.0

config SOC_HX6538
	select ARM
	select CPU_HAS_FPU
	select CPU_HAS_ARM_SAU
	select CPU_HAS_ARM_MPU
	select CPU_CORTEX_M55
	imply XIP
```

## soc/himax/hx6538/Kconfig.defconfig
```kconfig
# Copyright (c) 2024 Panoramix Labs
# SPDX-License-Identifier: Apache-2.0

if SOC_HX6538

config NUM_IRQS
	default 100

endif # SOC_HX6538

if SOC_HX6538_CM55M

config SYS_CLOCK_HW_CYCLES_PER_SEC
	default 400000000

endif # SOC_HX6538_CM55M

if SOC_HX6538_CM55S

config SYS_CLOCK_HW_CYCLES_PER_SEC
	default 150000000

endif # SOC_HX6538_CM55S
```

## soc/himax/hx6538/Kconfig.soc
```kconfig
# Copyright (c) 2024 Panoramix Labs
# SPDX-License-Identifier: Apache-2.0

config SOC_HX6538
	bool "HX6538 SoC, also known as 'WiseEye2' and 'EP II'"

config SOC_HX6538_CM55M
	bool "Main core with more resources"
	select SOC_HX6538
	help
	  Frequency up to 400 MHz

config SOC_HX6538_CM55S
	bool "Small core with fewer resources"
	select SOC_HX6538
	help
	  Frequency up to 150 MHz

config SOC
	default "HX6538" if SOC_HX6538
```
