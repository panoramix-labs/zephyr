/*
 * Copyright (c) 2024 Panoramix Labs
 *
 * SPDX-License-Identifier: Apache-2.0
 */

/dts-v1/;

#include <himax/hx6538_cm55m.dtsi>

/ {
	chosen {
		zephyr,console = &uart0;
		zephyr,sram = &dtcm;
		zephyr,flash = &itcm;
	};
};

&uart0 {
	status = "okay";
};
